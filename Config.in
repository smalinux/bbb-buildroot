## Config.in
```kconfig
source "$BR2_EXTERNAL_BBB_PATH/package/hello-world/Config.in"
source "$BR2_EXTERNAL_BBB_PATH/package/libtree/Config.in"
```

## kmodules/Config.in
```kconfig
menu "Out-of-tree kernel modules"

# Add a source line here for each module under kmodules/<name>/
source "$BR2_EXTERNAL_BBB_PATH/kmodules/kmod-hello/Config.in"

endmenu
```

## kmodules/kmod-hello/Config.in
```kconfig
config BR2_PACKAGE_KMOD_HELLO
	bool "kmod-hello"
	depends on BR2_LINUX_KERNEL
	help
	  Minimal out-of-tree kernel module example for the BeagleBone
	  Black. Prints a message on load/unload via pr_info(). Useful
	  as a template for new modules and as a smoke test for the
	  kmodules/ build infrastructure.

	  Load with: modprobe hello
	  Check dmesg for the "hello: loaded on BeagleBone Black" line.
```

## package/hello-world/Config.in
```kconfig
config BR2_PACKAGE_HELLO_WORLD
	bool "hello-world"
	help
	  A simple hello-world program that prints a greeting.
	  Demonstrates how to add a custom package to the
	  BR2_EXTERNAL tree.
```

## package/libtree/Config.in
```kconfig
config BR2_PACKAGE_LIBTREE
	bool "libtree"
	help
	  Like ldd, but displays shared library dependencies as a tree.
	  Useful for debugging missing or conflicting libraries on the
	  target.

	  https://github.com/haampie/libtree
```
